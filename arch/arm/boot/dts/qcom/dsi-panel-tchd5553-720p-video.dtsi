// Truva (Vestel Venus E4) panel: TCHD5553 720x1440 DSI video mode.
// Extracted verbatim from the stock flattened DTB (payloads unchanged).
// Reference it from the tree's panel list as &dsi_tchd5553_720p_video_truva.
// Panels are children of qcom,mdss_mdp@1a00000 (label &mdss_mdp) in this tree,
// so the definition is wrapped accordingly (confirmed against the stock DTB).

&mdss_mdp {
dsi_tchd5553_720p_video_truva: qcom,mdss_dsi_tchd5553_720p_video_truva {
	qcom,mdss-dsi-off-command-state = "dsi_hs_mode";
	qcom,mdss-dsi-panel-name = "truva tchd5553 720p video mode dsi panel";
	qcom,mdss-dsi-panel-type = "dsi_video_mode";
	qcom,mdss-dsi-te-check-enable;
	qcom,mdss-dsi-panel-controller = <&mdss_dsi0>;	/* was phandle 0xb5 (mdss_dsi_ctrl0) */
	qcom,mdss-dsi-off-command = <0x5010000 0x80000228 0x50100 0x960002 0x10002901 0x9600 0x2045a29 0x1000096 0x2055a>;
	qcom,mdss-dsi-h-sync-skew = <0x0>;
	qcom,mdss-dsi-bl-max-level = <0xfff>;
	qcom,mdss-dsi-lane-0-state;
	qcom,mdss-dsi-tx-eot-append;
	qcom,mdss-dsi-panel-width = <0x2d0>;
	qcom,mdss-dsi-bllp-eof-power-mode;
	qcom,mdss-dsi-v-bottom-border = <0x0>;
	qcom,mdss-dsi-bl-pmic-control-type = "bl_ctrl_wled";
	qcom,mdss-dsi-border-color = <0x0>;
	qcom,mdss-dsi-lane-1-state;
	qcom,mdss-dsi-h-front-porch = <0x50>;
	qcom,mdss-dsi-te-dcs-command = <0x1>;
	qcom,mdss-dsi-h-sync-pulse = <0x1>;
	qcom,mdss-dsi-dma-trigger = "trigger_sw";
	qcom,mdss-dsi-h-left-border = <0x0>;
	qcom,mdss-dsi-panel-timings = <0x8b1a1000 0x3e40161e 0x15030400>;
	qcom,mdss-dsi-mdp-trigger = "none";
	qcom,mdss-dsi-h-right-border = <0x0>;
	qcom,mdss-dsi-underflow-color = <0xff>;
	qcom,mdss-dsi-on-command-state = "dsi_lp_mode";
	qcom,mdss-dsi-lp11-init;
	qcom,mdss-dsi-panel-height = <0x5a0>;
	qcom,mdss-dsi-reset-sequence = <0x1 0xa 0x0 0x46 0x1 0x78>;
	qcom,mdss-dsi-bl-min-level = <0x1>;
	qcom,mdss-dsi-lane-2-state;
	qcom,mdss-dsi-h-pulse-width = <0x4>;
	qcom,mdss-dsi-t-clk-post = <0x4>;
	qcom,mdss-dsi-te-pin-select = <0x1>;
	qcom,mdss-dsi-te-using-te-pin;
	qcom,mdss-dsi-virtual-channel-id = <0x0>;
	qcom,mdss-dsi-lane-3-state;
	qcom,mdss-dsi-traffic-mode = "burst_mode";
	qcom,mdss-dsi-stream = <0x0>;
	qcom,mdss-dsi-t-clk-pre = <0x1b>;
	qcom,mdss-dsi-on-command = <0x29010000 0x200 0x390100 0x4 0xff871601 0x29010000 0x200 0x80390100 0x100003 0xff871629 0x1000000 0x20000 0x39010000 0x52a 0x2cf 0x29010000 0x200 0x290100 0x5 0x2b000005 0x9f290100 0x2 0xa02901 0x0 0x8b30302 0xd005a000 0x58290100 0x2 0x802901 0x0 0x10c000a6 0x101000 0xa6101000 0xad001010 0x290100 0x2 0xa02901 0x0 0x8c00501 0x1090126 0xb290100 0x2 0xd02901 0x0 0x8c00501 0x1090126 0xb290100 0x2 0x822901 0x0 0x4a54404 0xc290100 0x2 0x872901 0x0 0x5a50007 0x77772901 0x0 0x2008029 0x1000000 0xdc284 0x18183 0x18185 0x3ab529 0x1000000 0x200b0 0x29010000 0x10c2 0x84040007 0x86830500 0x7868202 0x78629 0x1000000 0x200c0 0x29010000 0x6c2 0x81030007 0x86290100 0x2 0xc52901 0x0 0x6c28103 0xaf0029 0x1000000 0x200da 0x29010000 0x3c2 0x33332901 0x0 0x200aa29 0x1000000 0x3c339 0x9c290100 0x2 0xac2901 0x0 0x2c39929 0x1000000 0x200d3 0x29010000 0x2c3 0x10290100 0x2 0xe32901 0x0 0x2c31029 0x1000000 0x20080 0x29010000 0xdcc 0x2030607 0x8090a18 0x22222222 0x29010000 0x200 0x90290100 0xd 0xcc030209 0x8070619 0xa222222 0x22290100 0x2 0xa02901 0x0 0x10cc1a1b 0x1c1d1e1f 0x18192021 0x414150a 0x22290100 0x2 0xb02901 0x0 0x6cc2222 0x22222229 0x1000000 0x20080 0x29010000 0x9cb 0x0 0x0 0x29010000 0x200 0x90290100 0x10 0xcb000000 0x0 0x0 0x0 0x29010000 0x200 0xa0290100 0x10 0xcb000000 0x0 0x0 0x0 0x29010000 0x200 0xb0290100 0x3 0xcb000029 0x1000000 0x200c0 0x29010000 0x10cb 0x5050505 0x5050505 0x0 0x5050529 0x1000000 0x200d0 0x29010000 0x10cb 0x5 0x5050505 0x500 0x29 0x1000000 0x200e0 0x29010000 0x3cb 0x2901 0x0 0x200f029 0x1000000 0x9cb0f 0xc0003f00 0xc0000029 0x1000000 0x20080 0x29010000 0x10cd 0x22191901 0x4060807 0x18170305 0x1a220f29 0x1000000 0x20090 0x29010000 0x4cd 0xe0d2229 0x1000000 0x200a0 0x29010000 0x10cd 0x22191902 0x5030708 0x18170604 0x1a220f29 0x1000000 0x200b0 0x29010000 0x4cd 0xe0d2229 0x1000000 0x20081 0x29010000 0xdf3 0x8c14008 0xc1400012 0x1200 0x29010000 0x200 0x80290100 0xa 0xce050078 0x78ff00 0x20052901 0x0 0x2009029 0x1000000 0x9ce00 0x5c0a3500 0x5c007b29 0x1000000 0x200b0 0x29010000 0x7ce 0x6060 0x602901 0x0 0x2009029 0x1000000 0x5cfff 0xfe0029 0x1000000 0x20094 0x29010000 0x5cf 0x1020 0x29010000 0x200 0xa4290100 0x5 0xcf000701 0x80290100 0x2 0xd02901 0x0 0x2cf0829 0x1000000 0x20080 0x29010000 0x2f3 0x70290100 0x2 0x2901 0x0 0x19e10007 0x192b3743 0x56656c75 0x7f886f67 0x645d4f43 0x362d2517 0xa072901 0x0 0x2000029 0x1000000 0x19e200 0x7192b37 0x4356656c 0x757f886f 0x67645d4f 0x43362d25 0x170a0729 0x1000000 0x20080 0x29010000 0xbc5 0xc1ddc4 0x141e0055 0x50002901 0x0 0x2009029 0x1000000 0xbc577 0x1e140088 0x104b3c55 0x50290100 0x2 0x2901 0x0 0x3d83131 0x29010000 0x200 0x88290100 0x3 0xc3333329 0x1000000 0x20098 0x29010000 0x3c3 0x33332901 0x0 0x2008029 0x1000000 0x2c441 0x29010000 0x200 0x94290100 0x2 0xc5482901 0x0 0x200c329 0x1000000 0x2f526 0x29010000 0x200 0xc7290100 0x2 0xf5262901 0x0 0x200d329 0x1000000 0x2f526 0x29010000 0x200 0xd7290100 0x2 0xf5262901 0x0 0x2009529 0x1000000 0x2f526 0x29010000 0x200 0x98290100 0x2 0xf5262901 0x0 0x200b129 0x1000000 0x2f521 0x29010000 0x200 0x81290100 0x3 0xcf050429 0x1000000 0x20084 0x29010000 0x3cf 0x5042901 0x0 0x2008129 0x1000000 0x2c4c0 0x29010000 0x200 0x8d290100 0x2 0xf5212901 0x0 0x2008c29 0x1000000 0x2f515 0x29010000 0x200 0xda290100 0x2 0xcf162901 0x0 0x200c129 0x1000000 0x2c011 0x29010000 0x200 0xbb290100 0x2 0xc2062901 0x0 0x200c129 0x1000000 0x2c206 0x29010000 0x200 0x89290100 0x2 0xcec82901 0x0 0x200c229 0x1000000 0x2c57c 0x29010000 0x200 0x290100 0x19 0xe100071a 0x2d39485a 0x6a737c84 0x8e69625f 0x584b3e31 0x29211508 0x7290100 0x2 0x2901 0x0 0x19e20007 0x1a2d3948 0x5a6a737c 0x848e6962 0x5f584b3e 0x31292115 0x8072901 0x0 0x2008129 0x1000000 0xacab9 0xffb9ffb9 0xff000000 0x29010000 0x200 0x290100 0x2 0xc6102901 0x0 0x2000029 0x1000000 0x13c7b0 0xabacbbcc 0xaabacbcb 0xbbc98867 0x45232211 0x11290100 0x2 0x2901 0x0 0x2c61129 0x1000000 0x20000 0x29010000 0x13c7 0xa09c9c9c 0xcd9aaacb 0xbbbbb988 0x78452322 0x22222901 0x0 0x2000029 0x1000000 0x2c612 0x29010000 0x200 0x290100 0x13 0xc7a09bab 0xabbc9ab9 0xbaabbbaa 0x88785634 0x33222229 0x1000000 0x20000 0x29010000 0x2c6 0x13290100 0x2 0x2901 0x0 0x13c7a09a 0xabaacb99 0xaac9aaba 0x9b888856 0x34333333 0x29010000 0x200 0x290100 0x2 0xc6142901 0x0 0x2000029 0x1000000 0x13c790 0x9baa9acb 0x99a9aaaa 0xaaab8888 0x67453333 0x33290100 0x2 0x2901 0x0 0x2c61529 0x1000000 0x20000 0x29010000 0x13c7 0x909aaa9a 0xca9999aa 0xaaa9ba88 0x88674544 0x44332901 0x0 0x2000029 0x1000000 0x2c616 0x29010000 0x200 0x290100 0x13 0xc7909a8a 0x9bc98999 0x9aaaa9aa 0x88887846 0x44444429 0x1000000 0x20000 0x29010000 0x2c6 0x17290100 0x2 0x2901 0x0 0x13c7908a 0x9a8ac989 0x99a9a999 0xba888878 0x56554444 0x29010000 0x200 0x290100 0x2 0xc6182901 0x0 0x2000029 0x1000000 0x13c780 0x9a998ab9 0x899999a9 0x99b98888 0x78565555 0x55290100 0x2 0x2901 0x0 0x2c61929 0x1000000 0x20000 0x29010000 0x13c7 0x808a9999 0xa98989a9 0x9989aa88 0x88886756 0x55552901 0x0 0x2000029 0x1000000 0x2c61a 0x29010000 0x200 0x290100 0x13 0xc7809999 0x89a89988 0x999989a9 0x88888867 0x66665629 0x1000000 0x20000 0x29010000 0x2c6 0x1b290100 0x2 0x2901 0x0 0x13c78089 0x9989a889 0x88999988 0xa9888888 0x78666666 0x29010000 0x200 0x290100 0x2 0xc61c2901 0x0 0x2000029 0x1000000 0x13c780 0x98988989 0x89989898 0x89988888 0x88787777 0x66290100 0x2 0x2901 0x0 0x2c61d29 0x1000000 0x20000 0x29010000 0x13c7 0x80888989 0x98798998 0x98889888 0x88888877 0x77772901 0x0 0x2000029 0x1000000 0x2c61e 0x29010000 0x200 0x290100 0x13 0xc7808898 0x88988889 0x88988898 0x88888888 0x88777729 0x1000000 0x20000 0x29010000 0x2c6 0x1f290100 0x2 0x2901 0x0 0x13c78088 0x88888889 0x88888888 0x98888888 0x88888878 0x29010000 0x200 0x290100 0x2 0xc6002901 0x0 0x251ff29 0x1000000 0x2532c 0x29010000 0x255 0x1290100 0x2 0x35000501 0xc800 0x2110005 0x1000064 0x22900>;
	qcom,mdss-dsi-v-front-porch = <0x10>;
	qcom,mdss-dsi-bpp = <0x18>;
	qcom,mdss-dsi-post-init-delay = <0x1>;
	qcom,mdss-dsi-panel-framerate = <0x3c>;
	qcom,mdss-dsi-v-pulse-width = <0x4>;
	qcom,mdss-dsi-h-back-porch = <0x50>;
	qcom,mdss-dsi-v-back-porch = <0x10>;
	qcom,mdss-dsi-v-top-border = <0x0>;
	qcom,panel-supply-entries = <&dsi_panel_pwr_supply>;	/* was phandle 0xb6; tree's standard vdd/vddio/lab/ibb supply (identical rails) */
	qcom,mdss-dsi-bllp-power-mode;
};
};	/* &mdss_mdp */
